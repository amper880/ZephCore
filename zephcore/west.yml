## zephcore/west.yml
```yaml
manifest:
  remotes:
    - name: zephyrproject-rtos
      url-base: https://github.com/zephyrproject-rtos

  projects:
    - name: zephyr
      remote: zephyrproject-rtos
      revision: c136c73d7be3305d2c07ee5726d4c6d0d985068b
      import: true

  self:
    path: zephcore
```
